## main/Kconfig.projbuild
```kconfig
menu "ESP PSX TOOLS"

    menu "WiFI & TCP"
        config PSX_WIFI_SSID
            string "WiFi SSID"
            default "wpa2_test"
            help
                SSID (network name) for the esp32 to connect to.

        config PSX_WIFI_PASS
            string "WiFi Password"
            default "123456789"
            help
                Password for the wifi SSID for the esp32 to connect to.

        config PSX_TCP_PORT
            int "TCP port to use to forward traffic to/from psx UART"
            default 1
            range 1 65535

        config PSX_ESP_DEBUG_LOGS
            bool "Enable debug logging for the ESP32"
            default n
            help
                Enable debug mode for the ESP32, opens a new tcp port with the logs.

        config PSX_TCP_PORT_LOGS
            int "TCP port to use to forward traffic to/from psx UART"
            default 2
            depends on PSX_ESP_DEBUG_LOGS
            range 1 65535

        choice
            prompt "LOG LEVEL"
            default PSX_ESP_DEBUG_LOGS_INFO
            depends on PSX_ESP_DEBUG_LOGS
            config PSX_ESP_DEBUG_LOGS_ERROR
                bool "Error"
            config PSX_ESP_DEBUG_LOGS_WARNING
                bool "Warning"
            config PSX_ESP_DEBUG_LOGS_INFO
                bool "Info"
            config PSX_ESP_DEBUG_LOGS_DEBUG
                bool "Debug"
            config PSX_ESP_DEBUG_LOGS_VERBOSE
                bool "Verbose"
        endchoice
    endmenu

    menu "PC UART"
        choice
            prompt "PSX SERIAL_PC_UART"
            default PSX_SERIAL_PC_UART_0
            config PSX_SERIAL_PC_UART_0
                bool "UART_NUM_0"
            config PSX_SERIAL_PC_UART_1
                bool "UART_NUM_1"
            config PSX_SERIAL_PC_UART_2
                bool "UART_NUM_2"
        endchoice
        config PSX_SERIAL_PC_TX
            int "TX gpio pin for the PC uart"
            range -1 40
            default -1
        config PSX_SERIAL_PC_RX
            int "RX gpio pin for the PC uart"
            range -1 40
            default -1
        choice
            prompt "PSX SERIAL_PC_BAUD"
            default PSX_SERIAL_PC_BAUD_115200
            config PSX_SERIAL_PC_BAUD_9600
                bool "9600 bps"
            config PSX_SERIAL_PC_BAUD_115200
                bool "115200 bps"
            config PSX_SERIAL_PC_BAUD_460800
                bool "460800 bps"
            config PSX_SERIAL_PC_BAUD_510000
                bool "510000 bps"
            config PSX_SERIAL_PC_BAUD_921600
                bool "921600 bps"
            config PSX_SERIAL_PC_BAUD_2000000
                bool "2 Mbps"
        endchoice
        config PSX_SERIAL_PC_STOP_BITS
            int "uart stop bits"
            range 1 2
            default 2
    endmenu

    menu "PSX UART"
        choice
            prompt "PSX SERIAL_PSX_UART"
            default PSX_SERIAL_PSX_UART_1
            config PSX_SERIAL_PSX_UART_1
                bool "UART_NUM_1"
                depends on !PSX_SERIAL_PC_UART_1
            config PSX_SERIAL_PSX_UART_2
                bool "UART_NUM_2"
                depends on !PSX_SERIAL_PC_UART_2
        endchoice
        config PSX_SERIAL_PSX_TX
            int "TX gpio pin for the psx uart"
            range -1 40
            default 12
        config PSX_SERIAL_PSX_RX
            int "RX gpio pin for the psx uart"
            range -1 40
            default 13
        choice
            prompt "PSX SERIAL_PSX_BAUD"
            default PSX_SERIAL_PSX_BAUD_115200
            config PSX_SERIAL_PSX_BAUD_9600
                bool "9600 bps"
            config PSX_SERIAL_PSX_BAUD_115200
                bool "115200 bps"
            config PSX_SERIAL_PSX_BAUD_518400
                bool "518400 bps (NoPS /fast option)"
        endchoice
        config PSX_SERIAL_PSX_STOP_BITS
            int "uart stop bits"
            range 1 2
            default 2
    endmenu

    menu "ACTIVITY LED"
        config PSX_SERIAL_LED
            int "LED pin on the esp32, set to -1 to disable"
            range -1 40
            default 5

        config PSX_SERIAL_LED_INVERT
            bool "On some boards the LED is on when set to 0 and off when set to 1, set this to make it work then"
            default y
    endmenu

endmenu
```

## sdkconfig.defaults
```kconfig
CONFIG_BOOTLOADER_COMPILER_OPTIMIZATION_PERF=y
CONFIG_BOOTLOADER_LOG_LEVEL_NONE=y
# CONFIG_BOOTLOADER_REGION_PROTECTION_ENABLE is not set
# CONFIG_BOOTLOADER_WDT_ENABLE is not set
CONFIG_BOOTLOADER_SKIP_VALIDATE_ALWAYS=y
CONFIG_ESPTOOLPY_FLASHMODE_QIO=y
CONFIG_ESPTOOLPY_FLASHFREQ_80M=y
CONFIG_ESPTOOLPY_FLASHSIZE_4MB=y
CONFIG_PARTITION_TABLE_SINGLE_APP_LARGE=y
CONFIG_PSX_ESP_DEBUG_LOGS=y
CONFIG_PSX_SERIAL_PSX_UART_2=y
CONFIG_COMPILER_OPTIMIZATION_PERF=y
CONFIG_COMPILER_OPTIMIZATION_ASSERTIONS_SILENT=y
CONFIG_COMPILER_OPTIMIZATION_CHECKS_SILENT=y
CONFIG_COMPILER_WARN_WRITE_STRINGS=y
CONFIG_SPI_MASTER_IN_IRAM=y
CONFIG_SPI_SLAVE_IN_IRAM=y
CONFIG_UART_ISR_IN_IRAM=y
CONFIG_GDMA_CTRL_FUNC_IN_IRAM=y
CONFIG_GDMA_ISR_IRAM_SAFE=y
CONFIG_ESP_TLS_SERVER=y
CONFIG_ESP32_DEFAULT_CPU_FREQ_240=y
# CONFIG_ESP32_DEBUG_OCDAWARE is not set
# CONFIG_ESP32_BROWNOUT_DET is not set
# CONFIG_ADC_CAL_EFUSE_TP_ENABLE is not set
# CONFIG_ADC_CAL_EFUSE_VREF_ENABLE is not set
# CONFIG_ADC_CAL_LUT_ENABLE is not set
# CONFIG_ESP_ERR_TO_NAME_LOOKUP is not set
# CONFIG_ETH_USE_ESP32_EMAC is not set
# CONFIG_ETH_USE_SPI_ETHERNET is not set
# CONFIG_ESP_EVENT_POST_FROM_ISR is not set
# CONFIG_HTTPD_ERR_RESP_NO_DELAY is not set
# CONFIG_ESP_NETIF_TCPIP_ADAPTER_COMPATIBLE_LAYER is not set
CONFIG_ESP_SYSTEM_PANIC_SILENT_REBOOT=y
CONFIG_ESP_CONSOLE_NONE=y
# CONFIG_ESP_INT_WDT is not set
# CONFIG_ESP_TASK_WDT is not set
CONFIG_ESP32_WIFI_STATIC_RX_BUFFER_NUM=25
CONFIG_ESP32_WIFI_DYNAMIC_RX_BUFFER_NUM=128
CONFIG_ESP32_WIFI_DYNAMIC_TX_BUFFER_NUM=128
CONFIG_ESP32_WIFI_TX_BA_WIN=32
CONFIG_ESP32_WIFI_RX_BA_WIN=32
CONFIG_ESP32_WIFI_TASK_PINNED_TO_CORE_1=y
CONFIG_ESP_WIFI_SLP_IRAM_OPT=y
# CONFIG_ESP_WIFI_SOFTAP_SUPPORT is not set
CONFIG_ESP_WIFI_ESPNOW_MAX_ENCRYPT_NUM=0
# CONFIG_FREERTOS_ENABLE_TASK_SNAPSHOT is not set
CONFIG_HEAP_ABORT_WHEN_ALLOCATION_FAILS=y
CONFIG_LOG_DEFAULT_LEVEL_NONE=y
CONFIG_LOG_MAXIMUM_LEVEL_VERBOSE=y
# CONFIG_LOG_COLORS is not set
# CONFIG_LWIP_DNS_SUPPORT_MDNS_QUERIES is not set
CONFIG_LWIP_L2_TO_L3_COPY=y
CONFIG_LWIP_IRAM_OPTIMIZATION=y
# CONFIG_LWIP_TIMERS_ONDEMAND is not set
# CONFIG_LWIP_SO_REUSE is not set
CONFIG_LWIP_SO_RCVBUF=y
CONFIG_LWIP_IP4_REASSEMBLY=y
CONFIG_NEWLIB_NANO_FORMAT=y
# CONFIG_SPI_FLASH_ENABLE_ENCRYPTED_READ_WRITE is not set
# CONFIG_WS_TRANSPORT is not set
```
